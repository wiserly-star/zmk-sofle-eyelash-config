#include <input/processors.dtsi>
#include <zephyr/dt-bindings/input/input-event-codes.h>
#include <behaviors.dtsi>
#include <dt-bindings/zmk/bt.h>
#include <dt-bindings/zmk/ext_power.h>
#include <dt-bindings/zmk/keys.h>
#include <dt-bindings/zmk/pointing.h>
#include <dt-bindings/zmk/outputs.h>
#include <dt-bindings/zmk/rgb.h>

#include "zmk-helpers/helper.h"
#include "zmk-helpers/key-labels/sofle_eyelash_3c.h"


/* ──────────────────────────────────────────────────────────────── */
/*                        Constants & Defaults                      */
/* ──────────────────────────────────────────────────────────────── */

#define COMBO_TERM_FAST 18
#define COMBO_TERM_SLOW 30

#define COMBO_IDLE_FAST 150
#define COMBO_IDLE_SLOW 50

#define XXX &none
#define ___ &trans

#define QUICK_TAP_MS 175

#define BASE 0
#define NAV 1
#define FN 2
#define SYS 3

#define DLEFT  &kp LC(LG(LEFT_ARROW))
#define DRIGHT &kp LC(LG(RIGHT_ARROW))
#define HYPER &kp LC(LA(LG(LSHFT)))

#define KEYS_L LT0 LT1 LT2 LT3 LT4 LM0 LM1 LM2 LM3 LM4 LB0 LB1 LB2 LB3 LB4  // Left-hand keys
#define KEYS_R RT0 RT1 RT2 RT3 RT4 RM0 RM1 RM2 RM3 RM4 RB0 RB1 RB2 RB3 RB4  // Right-hand keys
#define THUMBS LH4 LH3 LH2 LH1 LH0 RH0 RH1 RH2 RH3 RH4                      // Thumb keys

/* ──────────────────────────────────────────────────────────────── */
/*                     Home Row Mods (Timeless HRMs)                */
/* ──────────────────────────────────────────────────────────────── */

#define MAKE_HRM(NAME, HOLD, TAP, TRIGGER_POS)                                 \
  ZMK_HOLD_TAP(NAME, bindings = <HOLD>, <TAP>; flavor = "balanced";            \
               tapping-term-ms = <280>; quick-tap-ms = <QUICK_TAP_MS>;         \
               require-prior-idle-ms = <150>; hold-trigger-on-release;         \
               hold-trigger-key-positions = <TRIGGER_POS>;)

MAKE_HRM(hml, &kp, &kp, KEYS_R THUMBS) // Left-hand HRMs
MAKE_HRM(hmr, &kp, &kp, KEYS_L THUMBS) // Right-hand HRMs


/* ──────────────────────────────────────────────────────────────── */
/*                         Encoder behaviors                        */
/* ──────────────────────────────────────────────────────────────── */

/ {
  rgb_encoder: rgb_encoder {
      compatible = "zmk,behavior-sensor-rotate";
      #sensor-binding-cells = <0>;
      bindings = <&rgb_ug RGB_BRI>, <&rgb_ug RGB_BRD>;
      tap-ms = <20>;
  };

  vol_encoder: vol_encoder {
      compatible = "zmk,behavior-sensor-rotate";
      #sensor-binding-cells = <0>;
      bindings = <&vol_up_fine>, <&vol_dn_fine>;
      tap-ms = <20>;
  };
};


/* ──────────────────────────────────────────────────────────────── */
/*                            Nav cluster                           */
/* ──────────────────────────────────────────────────────────────── */

#define MT_CORE                                                                \
  flavor = "tap-preferred";                                                    \
  tapping-term-ms = <220>;                                                     \
  quick-tap-ms = <220>;                                                        \
  hold-trigger-key-positions = <0>;

&mt { MT_CORE };

// Modifier-morphing wrapper to mask accidental cursor jumps
#define MASK_MODS(NAME, MODS, BINDING)                                         \
  ZMK_MOD_MORPH(NAME, bindings = <BINDING>, <BINDING>; mods = <MODS>;)

MASK_MODS(masked_home, (MOD_LCTL), &kp HOME)
MASK_MODS(masked_end,  (MOD_LCTL), &kp END)

ZMK_HOLD_TAP(mt_home, bindings = <&masked_home>, <&kp>; MT_CORE)
ZMK_HOLD_TAP(mt_end, bindings = <&masked_end>, <&kp>; MT_CORE)

#define NAV_LEFT  &mt_home 0   LEFT  // Tap: left  | Long-tap: start of line.
#define NAV_RIGHT &mt_end 0    RIGHT // Tap: right | Long-tap: end   of line.
#define NAV_UP    &mt LC(HOME) UP    // Tap: up    | Long-tap: start of doc.
#define NAV_DOWN  &mt LC(END)  DOWN  // Tap: down  | Long-tap: end   of doc.


/* ──────────────────────────────────────────────────────────────── */
/*                              Combos                              */
/* ──────────────────────────────────────────────────────────────── */

ZMK_COMBO(selectall, &kp LC(A), LB4 LB3, BASE, COMBO_TERM_FAST, COMBO_IDLE_FAST)
ZMK_COMBO(copy,      &kp LC(C), LB3 LB2, BASE, COMBO_TERM_FAST, COMBO_IDLE_FAST)
ZMK_COMBO(paste,     &kp LC(V), LB2 LB1, BASE, COMBO_TERM_FAST, COMBO_IDLE_FAST)

ZMK_COMBO(lbkt, &kp LBKT, RB1 RB2, BASE, COMBO_TERM_FAST, COMBO_IDLE_FAST)
ZMK_COMBO(rbkt, &kp RBKT, RB2 RB3, BASE, COMBO_TERM_FAST, COMBO_IDLE_FAST)


/* ──────────────────────────────────────────────────────────────── */
/*                            Behaviors                             */
/* ──────────────────────────────────────────────────────────────── */

ZMK_BEHAVIOR(vol_up_fine, macro,
  bindings = <&macro_press &kp LSHIFT>, <&macro_press &kp LALT>, <&macro_tap &kp C_VOL_UP>, <&macro_release &kp LALT>, <&macro_release &kp LSHIFT>;
)

ZMK_BEHAVIOR(vol_dn_fine, macro,
  bindings = <&macro_press &kp LSHIFT>, <&macro_press &kp LALT>, <&macro_tap &kp C_VOL_DN>, <&macro_release &kp LALT>, <&macro_release &kp LSHIFT>;
)

ZMK_BEHAVIOR(mcaps, macro,
  tap-ms = <200>;
  bindings = <&kp CAPS>;
)


/* ──────────────────────────────────────────────────────────────── */
/*                           Mouse bindings                         */
/* ──────────────────────────────────────────────────────────────── */

#include "mouse.dtsi"


/*                             63 KEY MATRIX / LAYOUT MAPPING
Based on the pre-built Sofle split keyboards from AliExpress, seller 3C, Nice!View edition
https://github.com/a741725193/zmk-sofle

  ╭────────────────────────────╮                             ╭────────────────────────────╮
  │  0   1   2   3   4   5     │               ╭────╮        │      7   8   9  10  11  12 │
  │ 13  14  15  16  17  18     │           ╭───╯  6 ╰───╮    │     20  21  22  23  24  25 │
  │ 26  27  28  29  30  31     │  ╭────╮   │ 32  58  45 │    │     33  34  35  36  37  38 │
  │ 39  40  41  42  43  44     │  │ 52 │   ╰───╮ 19 ╭───╯    │     46  47  48  49  50  51 │
  ╰───────╮ 53  54  55  56  57 │  ╰────╯       ╰────╯        │ 59  60  61  62  63 ╭───────╯
          ╰────────────────────╯                             ╰────────────────────╯
  ╭─────────────────────────────╮                            ╭─────────────────────────────╮          
  │ LN5 LN4 LN3 LN2 LN1 LN0     │              ╭─────╮       │     RN0 RN1 RN2 RN3 RN4 RN5 │
  │ LT5 LT4 LT3 LT2 LT1 LT0     │          ╭───╯ JS0 ╰───╮   │     RT0 RT1 RT2 RT3 RT4 RT5 │
  │ LM5 LM4 LM3 LM2 LM1 LM0     │ ╭─────╮  │ JS1 JS2 JS3 │   │     RM0 RM1 RM2 RM3 RM4 RM5 │
  │ LB5 LB4 LB3 LB2 LB1 LB0     │ │ LEC │  ╰───╮ JS4 ╭───╯   │     RB0 RB1 RB2 RB3 RB4 RB5 │
  ╰───────╮ LH4 LH3 LH2 LH1 LH0 │ ╰─────╯      ╰─────╯       │ RH0 RH1 RH2 RH3 RH4 ╭───────╯
          ╰─────────────────────╯                            ╰─────────────────────╯         */

ZMK_LAYER(BASE,
  //                                                                                                             HAT CONTROLS
  // ╭─────────────┬─────────────┬─────────────┬─────────────┬─────────────┬─────────────╮                      ╭─────────────────╮  ╭─────────────┬─────────────┬─────────────┬─────────────┬─────────────┬─────────────╮
      &kp GRAVE     &kp N1        &kp N2        &kp N3        &kp N4        &kp N5                                &kp UP_ARROW        &kp N6        &kp N7        &kp N8        &kp N9        &kp N0        &kp BACKSPACE 
  // ├─────────────┼─────────────┼─────────────┼─────────────┼─────────────┼─────────────┤                      ├─────────────────┤  ├─────────────┼─────────────┼─────────────┼─────────────┼─────────────┼─────────────┤
      &kp TAB       &kp Q         &kp W         &kp E         &kp R         &kp T                                 &kp DOWN_ARROW      &kp Y         &kp U         &kp I         &kp O         &kp P         &kp BACKSLASH        
  // ├─────────────┼─────────────┼─────────────┼─────────────┼─────────────┼─────────────┤                      ├─────────────────┤  ├─────────────┼─────────────┼─────────────┼─────────────┼─────────────┼─────────────┤
      &mcaps        &kp A         &hml LALT S   &hml LGUI D   &hml LCTRL F  &kp G                                 &kp LEFT_ARROW      &kp H         &hmr RCTRL J  &hmr RGUI K   &hmr RALT L   &kp SEMI      &kp APOS        
  // ├─────────────┼─────────────┼─────────────┼─────────────┼─────────────┼─────────────┤                      ├─────────────────┤  ├─────────────┼─────────────┼─────────────┼─────────────┼─────────────┼─────────────┤
      &kp LSHIFT    &kp Z         &kp X         &kp C         &kp V         &kp B                                 &kp RIGHT_ARROW     &kp N         &kp M         &kp COMMA     &kp PERIOD    &kp SLASH     &kp RSHIFT
  // ╰┬──────────┬─┴─────────────┼─────────────┼─────────────┼─────────────┼─────────────┼─────────────╮   ╭────┴─────╮╭──────────┴──┴─────────────┼─────────────┼─────────────┼─────────────┼─────────────┼─────────────┼
       &kp C_MUTE                 &kp LCTRL     &kp LGUI      &kp SPACE     &mo NAV       &kp ESC           &mkp MCLK   HYPER         &mo FN        &kp ENTER     &kp RALT      &kp MINUS
  //  ╰──────────╯               ╰─────────────┴─────────────┴─────────────┴─────────────┴─────────────╯   ╰──────────╯╰─────────────┴─────────────┴─────────────┴─────────────┴─────────────╯
  //  ENCODER PRESS                                                                                         HAT PRESS
, &vol_encoder, "BASE")

ZMK_LAYER(NAV,
  //                                                                                                             HAT CONTROLS
  // ╭─────────────┬─────────────┬─────────────┬─────────────┬─────────────┬─────────────╮                      ╭─────────────────╮  ╭─────────────┬─────────────┬─────────────┬─────────────┬─────────────┬─────────────╮
      ___           &kp F1        &kp F2        &kp F3        &kp F4        &kp F5                               U_MS_U               &kp F6        &kp F7        &kp F8        &kp F11       &kp F12       &kp DEL 
  // ├─────────────┼─────────────┼─────────────┼─────────────┼─────────────┼─────────────┤                      ├─────────────────┤  ├─────────────┼─────────────┼─────────────┼─────────────┼─────────────┼─────────────┤
      ___           &kp PG_UP     NAV_UP        &kp PG_DN     &kp PG_UP     ___                                  U_MS_D               ___           ___           ___           ___           &kp PLUS      &kp KP_EQUAL        
  // ├─────────────┼─────────────┼─────────────┼─────────────┼─────────────┼─────────────┤                      ├─────────────────┤  ├─────────────┼─────────────┼─────────────┼─────────────┼─────────────┼─────────────┤
      ___           NAV_LEFT      NAV_DOWN      NAV_RIGHT     &kp PG_DN     ___                                  U_MS_L               ___           ___           ___           ___           ___           ___         
  // ├─────────────┼─────────────┼─────────────┼─────────────┼─────────────┼─────────────┤                      ├─────────────────┤  ├─────────────┼─────────────┼─────────────┼─────────────┼─────────────┼─────────────┤
      ___           DLEFT         DRIGHT        &kp C_PP      &kp C_PREV    &kp C_NEXT                           U_MS_R               &to BASE      &to NAV       &to SYS       ___           ___           ___ 
  // ╰┬──────────┬─┴─────────────┼─────────────┼─────────────┼─────────────┼─────────────┼─────────────╮   ╭────┴─────╮╭──────────┴──┴─────────────┼─────────────┼─────────────┼─────────────┼─────────────┼─────────────┼
       ___                        ___           ___           ___           ___          &kp LC(LA(DEL))    &mkp MCLK   ___           ___           ___           ___           ___
  //  ╰──────────╯               ╰─────────────┴─────────────┴─────────────┴─────────────┴─────────────╯   ╰──────────╯╰─────────────┴─────────────┴─────────────┴─────────────┴─────────────╯
  //  ENCODER PRESS                                                                                         HAT PRESS
, &vol_encoder, "NAV")

ZMK_LAYER(FN,
  //                                                                                                             HAT CONTROLS
  // ╭─────────────┬─────────────┬─────────────┬─────────────┬─────────────┬─────────────╮                      ╭─────────────────╮  ╭─────────────┬─────────────┬─────────────┬─────────────┬─────────────┬─────────────╮
      ___           &kp F1        &kp F2        &kp F3        &kp F4        &kp F5                               U_MS_U               &kp F6        &kp F7        &kp F8        &kp F11       &kp F12       &kp DEL 
  // ├─────────────┼─────────────┼─────────────┼─────────────┼─────────────┼─────────────┤                      ├─────────────────┤  ├─────────────┼─────────────┼─────────────┼─────────────┼─────────────┼─────────────┤
      ___           &kp PG_UP     NAV_UP        &kp PG_DN     &kp PG_UP     ___                                  U_MS_D               ___           ___           ___           U_MS_U        ___           &kp KP_EQUAL        
  // ├─────────────┼─────────────┼─────────────┼─────────────┼─────────────┼─────────────┤                      ├─────────────────┤  ├─────────────┼─────────────┼─────────────┼─────────────┼─────────────┼─────────────┤
      ___           NAV_LEFT      NAV_DOWN      NAV_RIGHT     &kp PG_DN     ___                                  U_MS_L               ___           U_WH_U        U_MS_L        U_MS_D        U_MS_R        U_WH_D         
  // ├─────────────┼─────────────┼─────────────┼─────────────┼─────────────┼─────────────┤                      ├─────────────────┤  ├─────────────┼─────────────┼─────────────┼─────────────┼─────────────┼─────────────┤
      ___           ___           ___           ___           ___           ___                                  U_MS_R               &to BASE      &to NAV       &to SYS       ___           ___           ___ 
  // ╰┬──────────┬─┴─────────────┼─────────────┼─────────────┼─────────────┼─────────────┼─────────────╮   ╭────┴─────╮╭──────────┴──┴─────────────┼─────────────┼─────────────┼─────────────┼─────────────┼─────────────┼
       ___                        ___           ___           ___           ___           ___               &mkp MCLK   ___           ___           ___           ___           ___
  //  ╰──────────╯               ╰─────────────┴─────────────┴─────────────┴─────────────┴─────────────╯   ╰──────────╯╰─────────────┴─────────────┴─────────────┴─────────────┴─────────────╯
  //  ENCODER PRESS                                                                                         HAT PRESS
, &vol_encoder, "FN")

ZMK_LAYER(SYS,
  //                                                                                                             HAT CONTROLS
  // ╭─────────────┬─────────────┬─────────────┬─────────────┬─────────────┬─────────────╮                      ╭─────────────────╮  ╭─────────────┬─────────────┬─────────────┬─────────────┬─────────────┬─────────────╮
      ___           &bt BT_SEL 0  &bt BT_SEL 1  &bt BT_SEL 2  &bt BT_SEL 3  &bt BT_SEL 4                         &rgb_ug RGB_HUI      ___           ___           ___           ___           ___           ___ 
  // ├─────────────┼─────────────┼─────────────┼─────────────┼─────────────┼─────────────┤                      ├─────────────────┤  ├─────────────┼─────────────┼─────────────┼─────────────┼─────────────┼─────────────┤
      ___           ___           ___           ___           ___           ___                                  &rgb_ug RGB_HUD      ___           &out OUT_USB  ___           ___           ___           ___        
  // ├─────────────┼─────────────┼─────────────┼─────────────┼─────────────┼─────────────┤                      ├─────────────────┤  ├─────────────┼─────────────┼─────────────┼─────────────┼─────────────┼─────────────┤
      ___           ___           ___           ___           ___           ___                                  &rgb_ug RGB_SAD      ___           ___           ___           ___           ___           ___
  // ├─────────────┼─────────────┼─────────────┼─────────────┼─────────────┼─────────────┤                      ├─────────────────┤  ├─────────────┼─────────────┼─────────────┼─────────────┼─────────────┼─────────────┤
      ___           ___           ___           &bt BT_CLR    ___           &out OUT_BLE                         &rgb_ug RGB_SAI      &to SYS      &to NAV        XXX           ___           ___           ___ 
  // ╰┬──────────┬─┴─────────────┼─────────────┼─────────────┼─────────────┼─────────────┼─────────────╮   ╭────┴─────╮╭──────────┴──┴─────────────┼─────────────┼─────────────┼─────────────┼─────────────┼─────────────┼
       &rgb_ug RGB_TOG            ___           ___           ___           ___           ___               &mkp LCLK   ___           ___           ___           ___           ___
  //  ╰──────────╯               ╰─────────────┴─────────────┴─────────────┴─────────────┴─────────────╯   ╰──────────╯╰─────────────┴─────────────┴─────────────┴─────────────┴─────────────╯
  //  ENCODER PRESS                                                                                         HAT PRESS
, &rgb_encoder, "SYS")

// Preserve the two user layers backed up from ZMK Studio.
#include "preserved-studio-keymap.dtsi"
